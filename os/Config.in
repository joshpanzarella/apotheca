## os/Config.in
```kconfig
menu "Apotheca"
	source "$BR2_EXTERNAL_APOTHECA_PATH/package/apotheca/Config.in"
	source "$BR2_EXTERNAL_APOTHECA_PATH/package/apotheca-tools/Config.in"
	source "$BR2_EXTERNAL_APOTHECA_PATH/package/rocknix-joypad/Config.in"
endmenu
```

## os/package/apotheca-tools/Config.in
```kconfig
config BR2_PACKAGE_APOTHECA_TOOLS
	bool "apotheca-tools"
	depends on BR2_PACKAGE_SDL2
	help
	  apotheca-power (/usr/sbin: the power key and the battery,
	  started by inittab), apotheca-splash (the start-up picture
	  with its planet band turning, at start-up and at turn-off;
	  its picture, splash.bin, is made by os/tools/make-logo.py),
	  and two small programs for bring-up and
	  the desk test: padprobe (what SDL sees of the joysticks, in
	  controls.txt's numbers) and fakepad (a uinput stand-in for the
	  RG40XXV's joypad and power key, for qemu). In
	  /usr/libexec/apotheca.
```

## os/package/apotheca/Config.in
```kconfig
config BR2_PACKAGE_APOTHECA
	bool "apotheca"
	depends on BR2_INSTALL_LIBSTDCPP
	depends on BR2_TOOLCHAIN_HAS_THREADS
	select BR2_PACKAGE_SDL2
	help
	  Apotheca itself, built from this repository by Buildroot's
	  toolchain, with its lettering, chord packs and licences, in
	  /usr/lib/apotheca. /usr/sbin/apotheca-start runs it from the
	  card's DATA partition (/data/apotheca), where its songs,
	  recordings and updates live.
```

## os/package/rocknix-joypad/Config.in
```kconfig
config BR2_PACKAGE_ROCKNIX_JOYPAD
	bool "rocknix-joypad"
	depends on BR2_LINUX_KERNEL
	help
	  ROCKNIX's joypad driver: the H700 handhelds' buttons (GPIO)
	  and stick (the ADC behind an analog mux) as one input device.
	  ROCKNIX's device trees for these units name it (patch 0140).

	  https://github.com/ROCKNIX/rocknix-joypad
```
